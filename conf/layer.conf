## conf/layer.conf
```bitbake
# We have a conf and classes directory, add to BBPATH
BBPATH .= ":${LAYERDIR}"

# We have recipes-* directories, add to BBFILES
BBFILES += "${LAYERDIR}/recipes-*/*/*.bb \
            ${LAYERDIR}/recipes-*/*/*.bbappend"

BBFILE_COLLECTIONS += "hp-dm"
BBFILE_PATTERN_hp-dm = "^${LAYERDIR}/"
BBFILE_PRIORITY_hp-dm = "1"

LAYERVERSION_hp-dm = "1"
```

## conf/local.conf
```bitbake
CORE_IMAGE_EXTRA_INSTALL += "openssh"
CORE_INSTALL_append += "postmark"
CORE_INSTALL_append += "bbexample"
```
